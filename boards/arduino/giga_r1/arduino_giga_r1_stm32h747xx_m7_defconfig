## boards/arduino/mezza_exps/board.yml
```yaml
board:
  name: arduino_mezza_exps
  full_name: Arduino Expansions
  vendor: arduino
  socs:
    - name: stm32c552xx
  variants:
    - name: inmainmcu
      qualifier: inmainmcu
    - name: iniomcu
      qualifier: iniomcu
```

## boards/arduino/mezza_in/Kconfig.arduino_mezza_in
```kconfig
# Copyright (c) 2026 Arduino SA
# SPDX-License-Identifier: Apache-2.0

config BOARD_ARDUINO_MEZZA_IN
	select SOC_STM32C552XX
```

## boards/arduino/mezza_in/arduino_mezza_in_defconfig
```kconfig
# SPDX-License-Identifier: Apache-2.0

# --- VARIOUS
CONFIG_FPU=y
CONFIG_FLASH=y
CONFIG_COUNTER=y

# --- MEMORY & STACK
CONFIG_ICACHE=y
CONFIG_DCACHE=y
CONFIG_CACHE_MANAGEMENT=y
CONFIG_MEMC=y
CONFIG_ARM_MPU=n
CONFIG_HEAP_MEM_POOL_SIZE=4096
CONFIG_COMMON_LIBC_MALLOC_ARENA_SIZE=-1
CONFIG_HW_STACK_PROTECTION=y
CONFIG_MAIN_STACK_SIZE=2048

# --- THREAD
CONFIG_THREAD_STACK_INFO=y
CONFIG_DYNAMIC_THREAD=y
CONFIG_DYNAMIC_THREAD_POOL_SIZE=2
CONFIG_DYNAMIC_THREAD_ALLOC=y
CONFIG_MAIN_THREAD_PRIORITY=5

# --- LLEXT
CONFIG_LLEXT_STORAGE_WRITABLE=n
CONFIG_LLEXT_HEAP_SIZE=128
# !!! TODO: REMOVE the following setting
CONFIG_LLEXT_MAX_INIT_FINI_FUNCTION_TABLE_ENTRIES=16

# --- USB & CDC
CONFIG_USB_DEVICE_STACK_NEXT=y
CONFIG_USBD_CDC_ACM_CLASS=y
CONFIG_CDC_ACM_SERIAL_INITIALIZE_AT_BOOT=n
CONFIG_CDC_ACM_SERIAL_PRODUCT_STRING="Arduino Mezza"
CONFIG_CDC_ACM_SERIAL_MANUFACTURER_STRING="Arduino"
CONFIG_CDC_ACM_DTE_RATE_CALLBACK_SUPPORT=y
CONFIG_USB_DEVICE_VID=0x1209
CONFIG_USB_DEVICE_PID=0xca01

# --- UART
CONFIG_SERIAL=y
CONFIG_UART_LINE_CTRL=y
CONFIG_UART_INTERRUPT_DRIVEN=y

# --- CONSOLE
CONFIG_CONSOLE=y
CONFIG_UART_CONSOLE=y

# --- GPIO
CONFIG_GPIO=y

# --- ADC & DAC
CONFIG_ADC=y

# --- DMA
CONFIG_DMA=y

# ---  I2C
CONFIG_I2C=y
CONFIG_I2C_TARGET=y
CONFIG_I2C_EEPROM_TARGET=y

# --- SPI
CONFIG_SPI=y
CONFIG_SPI_ASYNC=y
CONFIG_SPI_STM32=y
CONFIG_SPI_STM32_DMA=y
CONFIG_SPI_STM32_INTERRUPT=y

# --- LOG & DEBUG
CONFIG_LOG=y
CONFIG_LOG_MODE_IMMEDIATE=y
CONFIG_FAULT_DUMP=2
CONFIG_HWINFO=y
#CONFIG_UART_LOG_LEVEL_DBG=y
#CONFIG_SPI_LOG_LEVEL_DBG=y
#CONFIG_SDHC_LOG_LEVEL_DBG=y
#CONFIG_SDMMC_LOG_LEVEL_DBG=y
#CONFIG_I2C_LOG_LEVEL_DBG=y
#CONFIG_CAN_LOG_LEVEL_DBG=y
#CONFIG_DEBUG_THREAD_INFO=y
#CONFIG_UART_LOG_LEVEL_OFF=y
```

## boards/arduino/mezza_in/board.yml
```yaml
board:
  name: arduino_mezza_in
  full_name: Arduino MezzaIn
  vendor: arduino
  socs:
    - name: stm32c552xx
```

## boards/arduino/mezza_out/arduino_mezza_out_defconfig
```kconfig
# SPDX-License-Identifier: Apache-2.0

# --- VARIOUS
CONFIG_FPU=y
CONFIG_FLASH=y
#CONFIG_COUNTER=y

# --- MEMORY & STACK
#CONFIG_MEMC=y
CONFIG_ARM_MPU=n
CONFIG_HEAP_MEM_POOL_SIZE=4096
CONFIG_COMMON_LIBC_MALLOC_ARENA_SIZE=-1
CONFIG_HW_STACK_PROTECTION=y
CONFIG_MAIN_STACK_SIZE=2048

# --- THREAD
CONFIG_THREAD_STACK_INFO=y
CONFIG_DYNAMIC_THREAD=y
CONFIG_DYNAMIC_THREAD_POOL_SIZE=2
CONFIG_DYNAMIC_THREAD_ALLOC=y
CONFIG_MAIN_THREAD_PRIORITY=5

# --- LLEXT

# --- USB & CDC
CONFIG_USB_DEVICE_STACK_NEXT=y
CONFIG_USBD_CDC_ACM_CLASS=y
CONFIG_CDC_ACM_SERIAL_INITIALIZE_AT_BOOT=n

# --- UART
CONFIG_SERIAL=y
CONFIG_UART_LINE_CTRL=y
CONFIG_UART_INTERRUPT_DRIVEN=y

# --- CONSOLE
CONFIG_CONSOLE=y
CONFIG_UART_CONSOLE=y

# --- GPIO
CONFIG_GPIO=y

# --- ADC & DAC
CONFIG_ADC=y

# --- DMA
CONFIG_DMA=n

# ---  I2C
CONFIG_I2C=y
CONFIG_I2C_TARGET=y

# --- SPI
CONFIG_SPI=y
CONFIG_SPI_ASYNC=y
CONFIG_SPI_STM32=y
#CONFIG_SPI_STM32_DMA=y
CONFIG_SPI_STM32_INTERRUPT=y

# --- LOG & DEBUG
CONFIG_LOG=y
CONFIG_LOG_MODE_IMMEDIATE=y
CONFIG_FAULT_DUMP=2
CONFIG_HWINFO=y
#CONFIG_UART_LOG_LEVEL_DBG=y
#CONFIG_SPI_LOG_LEVEL_DBG=y
#CONFIG_SDHC_LOG_LEVEL_DBG=y
#CONFIG_SDMMC_LOG_LEVEL_DBG=y
#CONFIG_I2C_LOG_LEVEL_DBG=y
#CONFIG_CAN_LOG_LEVEL_DBG=y
#CONFIG_DEBUG_THREAD_INFO=y
#CONFIG_UART_LOG_LEVEL_OFF=y
```

## boards/arduino/mezza_out/board.yml
```yaml
boards:
  - name: arduino_mezza_in
    full_name: Arduino MezzaIn
    vendor: arduino
    socs:
      - name: stm32c552xx
  - name: arduino_mezza_in_sub
    full_name: Arduino MezzaInSub
    vendor: arduino
    socs:
      - name: stm32c552xx
```

## drivers/dfsdm/Kconfig
```kconfig
# drivers/dfsdm/Kconfig

menuconfig DFSDM
    bool "Digital Filter for Sigma Delta Modulators (DFSDM) Drivers"
    help
      Enable support for DFSDM drivers.

if DFSDM

config DFSDM_STM32
    bool "STM32 DFSDM driver"
    default y
    depends on DT_HAS_ST_STM32_DFSDM_FILTER_ENABLED
    select DMA
    help
      Enable STM32 DFSDM driver.

config DFSDM_INIT_PRIORITY
     int "DFSDM init priority"
     default 60
     help
          Device driver initialization priority.
          Must be lower than application priority but higher than
          kernel services.

module = DFSDM
module-str = dfsdm
source "subsys/logging/Kconfig.template.log_config"

endif # DFSDM
```

## dts/bindings/dfdsm/st,stm32-dfsdm-filter.yaml
```yaml
description: STM32 DFSDM Filter

compatible: "st,stm32-dfsdm-filter"

include: [base.yaml]

properties:
  dmas:
    type: phandle-array
    description: DMA channel specifier

  dma-names:
    type: string-array
    description: DMA request name

  label:
    type: string
```
